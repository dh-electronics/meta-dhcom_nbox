## conf/layer.conf
```bitbake
# We have a conf and classes directory, add to BBPATH
BBPATH .= ":${LAYERDIR}"

# We have recipes-* directories, add to BBFILES
BBFILES += "${LAYERDIR}/recipes-*/*/*.bb \
            ${LAYERDIR}/recipes-*/*/*.bbappend"

BBFILE_COLLECTIONS += "meta-dhcom_nbox"
BBFILE_PATTERN_meta-dhcom_nbox = "^${LAYERDIR}/"
BBFILE_PRIORITY_meta-dhcom_nbox = "6"

LAYERDEPENDS_meta-dhcom_nbox = "core meta-dhcom_imx6"
LAYERSERIES_COMPAT_meta-dhcom_nbox = "thud"
```

## conf/machine/dhcom1bimx6ull_nbox.conf
```bitbake
#@TYPE: Machine
#@NAME: DHCOM i.MX6 UltraLight
#@SOC: i.MX6UL
#@DESCRIPTION: Machine configuration for DHCOM i.MX6 Ultralight

require conf/machine/include/dhcom_imx6-common.inc
include conf/machine/include/tune-cortexa7.inc

#SOC_FAMILY = "mx6:mx6ull:"
MACHINEOVERRIDES =. "mx6:mx6ull:"

UBOOT_CONFIG ??= "ull"

KERNEL_DEVICETREE ?= "imx6ull-dhcom-nbox.dtb"
PREFERRED_PROVIDER_virtual/kernel = "linux-imx6-dhcom-nbox"
PREFERRED_VERSION_linux-imx6-dhcom = "4.19.135"
KERNEL_DEFCONFIG ?= "imx6ull_nbox_defconfig"

do_rootfs[depends] += "imx6ull-dhcom-nbox-ulinuxenvtxt:do_deploy"
do_rootfs[depends] += "splash:do_deploy"
IMAGE_BOOT_FILES += "uLinuxEnv.txt 800x480_done.bmp 800x480_error.bmp 800x480_progress.bmp splash.bmp settings.bin"

WKS_FILE = "dhcom-uboot-bootpart.wks"

IMAGE_BOOTLOADER ?= "u-boot"
MACHINE_FEATURES_append=" bluetooth"
```
